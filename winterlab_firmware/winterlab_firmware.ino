// Firmware for WinterLab platform, designed to be run on a Teensy 3.6
// Author: M Rouble
// Last updated: 2020


#define ARM_MATH_CM4
#include <DMAChannel.h>
#include "pdb.h"
#include <avr/pgmspace.h>
#include <ADC.h>
#include <array>
#include <arm_math.h>


// Define pinout, wavetables, global settings

DMAChannel dma0(false);
DMASetting dma1;
DMASetting dma2;

ADC *adc = new ADC();
const int readPin0 = A0;
const int readPin1 = A2;

const int meterPinOut = A9; 
const int meterPinIn = A17;
const int meterPinRef = A7;
const int voltMeterPin = A16;
const int dcpin = A21;
int rangeDMM;

char rangeBuff[2]; // 2 through 6, powers of ten


// the DAC uses a direct digital synthesis algorithm to generate waveforms
// for more info, see for example https://www.analog.com/media/en/training-seminars/tutorials/MT-085.pdf
const uint16_t sinetable[] PROGMEM = {
  2047, 2050, 2053, 2056, 2060, 2063, 2066, 2069, 2072, 2075, 2078, 2082,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 2041, 2044};

const uint16_t squaretable[] PROGMEM = {
   0, 0, 0, 0, 0, 0, 0, 0, 0, 0, 0, 0,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 4095, 4095};

const uint16_t lintable[] PROGMEM = { 
   0, 1, 2, 3, 4, 5, 6, 7, 8, 9, 10, 11,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 4094, 4095};

const uint16_t tritable[] PROGMEM = {   
    0, 1, 3, 5, 7, 9, 11, 13, 15, 17, 19, 21,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 3, 1};
    
const uint16_t noisetable[] PROGMEM = {
    859, 3320, 2989, 3195, 180, 1553, 3443, 1369, 747, 2021, 1367, 1328,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 487, 11};

int i;
byte value;
int N = 4096;
int table_res = 12;
float f_clk = 4096000;
const int bufferlen = 4096;

DMAMEM uint16_t table1[bufferlen];
DMAMEM uint16_t table2[bufferlen];
uint16_t alttable[bufferlen];

int wave;
float freq;
float amp;
float M;
int m_extend;
unsigned long m;
unsigned long pac;
unsigned long pac_comp;

char startword;

int trig;
int trigchannel;
char trigbuff[5];
char chbuff[2];

int dcoffset;
char offsetbuff[6];
int ypos;

char voltbuff[4]; //stores the voltage generator voltage
int volts;
int buffvolts; //used to check if incoming voltage is within range

char freqbuff[7]; //to change the frequency
char ampbuff[6];

int metered; //for the volt meter
byte bmetered;
int ometered;

const unsigned int numValues = 1024; // ADC batch length
int counter;

byte readValues0[numValues];
byte readValues1[numValues];

byte readValues[2][numValues];

int ledpin = 13;

bool prep_flag;
bool flag1;
int place;
bool upflag;


// Interrupt service routine (ISR) used to flag that the DMA buffer is ready
void dma_isr() {
  flag1 = !flag1;
  digitalWrite(ledpin, !digitalRead(ledpin));
  prep_flag = true;
  dma0.clearInterrupt();
}



void setup()
  // Purpose: Establishes pin settings and starting values.
  //          Does some black magic to initialize the DACs and ADCs to run at high speed.
  // Date added: Aug. 2017
  // Data modified: Jan 2019
  
{
  Serial.begin(115200);

  analogWriteResolution(8);
  analogReadResolution(8);
  analogReadAveraging(8);
  
  pinMode(readPin0, INPUT);
  pinMode(readPin1, INPUT);
  pinMode(meterPinOut, OUTPUT);
  pinMode(meterPinRef, INPUT);
  pinMode(meterPinIn, INPUT);
  pinMode(ledpin, OUTPUT);
  pinMode(dcpin, OUTPUT);
  pinMode(A22, OUTPUT); // what is A22

  freq = 1000.0; //default values

  trig = 127;
  trigchannel = 1;

  for(int i = 0; i<bufferlen; i++) { //clear the output table
    table1[i] = 0;
    table2[i] = 0;
  }

  amp = 0.2;
  ypos = 0;
  dcoffset = 2048;
  m_extend = 8; // bit boost for phase acc.
  M = ((float)freq * (float)pow(2,table_res)) / (float)f_clk;
  m = M*pow(2, m_extend);
  pac = 0;
  pac_comp = pow(2, 24);
  wave = 6; //blank
 
  counter = 0;

  metered = 0; 
  bmetered = 0;

  rangeDMM = 100;

  adc->setAveraging(1);
  adc->setResolution(8);
  adc->setConversionSpeed(ADC_CONVERSION_SPEED::VERY_HIGH_SPEED);
  adc->setSamplingSpeed(ADC_SAMPLING_SPEED::VERY_HIGH_SPEED);

  adc->setAveraging(1, ADC_1);
  adc->setResolution(8, ADC_1);
  adc->setConversionSpeed(ADC_CONVERSION_SPEED::VERY_HIGH_SPEED, ADC_1);
  adc->setSamplingSpeed(ADC_SAMPLING_SPEED::VERY_HIGH_SPEED, ADC_1);

  adc->startSynchronizedContinuous(readPin0, readPin1);
  delay(500);

  // Configure PDB block for DMA timing
  SIM_SCGC2 |= SIM_SCGC2_DAC1; // enable DAC clock
  DAC1_C0 = DAC_C0_DACEN | DAC_C0_DACRFS; // enable the DAC module, 3.3V reference
  // slowly ramp up to DC voltage, approx 1/4 second
  for (int16_t i=0; i<2048; i+=8) {
    *(int16_t *)&(DAC1_DAT0L) = i;
    delay(1);
  }

  // set the programmable delay block to trigger DMA requests
  SIM_SCGC6 |= SIM_SCGC6_PDB; // enable PDB clock
  PDB0_IDLY = 0; // interrupt delay register
  //PDB0_MOD = PDB_PERIOD; // modulus register, sets period
  PDB0_MOD = 14;
  PDB0_SC = PDB_CONFIG | PDB_SC_LDOK; // load registers from buffers
  PDB0_SC = PDB_CONFIG | PDB_SC_SWTRIG; // reset and restart
  PDB0_CH0C1 = 0x0101; // channel n control register?

  dma0.begin(true);
  dma0.triggerAtHardwareEvent(DMAMUX_SOURCE_PDB);
  
  dma1.sourceBuffer(table1, sizeof(table1));
  dma1.destination(*(volatile uint16_t *)&(DAC1_DAT0L));
  dma1.interruptAtCompletion();
  dma1.replaceSettingsOnCompletion(dma2);

  dma2.sourceBuffer(table2, sizeof(table2));
  dma2.destination(*(volatile uint16_t *)&(DAC1_DAT0L));
  dma2.interruptAtCompletion();
  dma2.replaceSettingsOnCompletion(dma1);

  dma0 = dma1;
  dma0.enable();
  dma0.attachInterrupt(dma_isr);
  
  
  // set up the starting output values --> DC supply, function generator
  analogWrite(dcpin, 128);
  wave = 6;
  prep_flag = false;
  flag1 = false;
  place = 0;
  
}

int value0 = 0;
int value1 = 0;

ADC::Sync_result result;



void readFromSerial() {
  // Purpose: parses input from python GUI and directs board to take assigned action.
  // Date added: Aug. 2017
  // Data modified: Jan 2019
  
  startword = Serial.read();
  if (startword == 'F') {
    getFreq();
  }
  if (startword == 'A') {
    getAmp();
  }
  if (startword == 'S') {
    wave = 1; //sine
    Serial.println('0');
  }
  if (startword == 'R') {
    wave = 2; //tri
    Serial.println('0');
  }
  if (startword == 'U') {
    wave = 3; //saw
    Serial.println('0');
  }
  if (startword == 'Q') {
    wave = 4; //square
    Serial.println('0');
  }
  if (startword == 'W') {
    wave = 5; //noise
    Serial.println('0');
  }
  if (startword == 'B') {
    wave = 6; //off
    Serial.println('0');
  }
  if (startword == 'M') {
    getVoltMeter();
  }
  if (startword == 'O') {
    getOhmMeter();
  }
  if(startword == 'I') {
    getCapMeter();
  }
  if (startword == 'H') {
    getDMMRange();
  }
  if (startword == 'T') {
    getTrigger();
  }
  if (startword == 'C') {
    getTriggerChannel();
  }
  if (startword == 'D') {
    getOffset();
  }
  if (startword == 'Z') {
    twoChannelOsc();
  }
  if(startword == 'E') {
    measureRange(0);
  }
  if(startword == 'G') {
    measureRange(1);
  }
  if(startword == 'J') {
    getDC();
  }
  
  else {
    while (Serial.available()) {
      char t = Serial.read();
    }
  }
}

void getVoltMeter() { 
  // Purpose: Reads a voltage at the voltMeterPin and reports it
  // Date added: Aug. 2017
  // Data modified: Nov 2018
  
  float metered = 0;
  int sum = 0;
  for(int i=0; i<100; i++) {
    sum = sum + analogRead(voltMeterPin);
  }
  metered = (float)sum/100.0;
  Serial.flush();
  Serial.print(metered);
  Serial.println("");
  delay(10);
 
}

void getDMMRange() { 
  // Purpose: reads the current multimeter range from Python (2: 100ohm, 3: 1k, 4: 10k, 5: 100k, 6: 1M)
  // Date added: Oct. 2018
  // Data modified: Oct. 2018
  Serial.readBytesUntil('\n', rangeBuff, 2);
  rangeBuff[1] = '\0';
  int mult = atoi(rangeBuff);
  rangeDMM = pow(10, mult);
  Serial.println('0');
}


void getOhmMeter() {
  // Purpose: uses a voltage divider to measure the value of an unknown resistance.
  // Date added: Aug. 2017
  // Data modified: Jan 2019
  digitalWrite(meterPinOut, HIGH);
  int vreftot = 0;
  int vmtot = 0;
  int R2;
  for(int i = 0; i < 100; i ++) {
    vreftot = vreftot + analogRead(meterPinRef);
    vmtot = vmtot + analogRead(meterPinIn);    
  }
  digitalWrite(meterPinOut, LOW);
  float vrefavg = (float)vreftot/100.0;
  float vmavg = (float)vmtot/100.0;

  if(vmavg <= vrefavg*0.1 ){  
      R2 = -1; // Range error; range too small
    }
  else  if(vmavg >= vrefavg*0.9) {
      R2 = -2; // Range error: range too large
    } 
  else {
    R2 = rangeDMM*(vrefavg/vmavg - 1);
  }
  Serial.flush();
  Serial.println(R2);
}

void getCapMeter() {
  // Purpose: Determines the value of a capacitance attached at the measure point
  // Date added: Oct. 2018
  // Date modified: Feb 2019 added adaptive measurement delay to extend range

 
  byte measured[1000];
  byte ref[1000];
  float C;
  
  long timerend;
  byte success = 0;
  int i;
  long timerstart = micros();
  int range_delay=10;
  if(rangeDMM == 1000 || rangeDMM == 10000) {
    range_delay = 10;
  }
  else if(rangeDMM == 1000000) {
    range_delay = 20;
  }
  else {
    range_delay = 10;
  }
  digitalWrite(meterPinOut, HIGH);
  for(i=0; i<1000; i++) { 
    measured[i] = analogRead(meterPinIn);
    ref[i] = analogRead(meterPinRef);
    if(i>0) {
      if(measured[i-1] > measured[i]) {
   
        if(measured[i] <= 255.0*0.367) {
          timerend = micros() - timerstart;
          //Serial.println(timerend);
            if(i>20) {
              success = 1;
              }
            if(i<20) {
              success = -1; //range too low
              }
          }
        if(success != 0) {
          break;
        }
      }
    }
    delayMicroseconds(range_delay);   
  }
  digitalWrite(meterPinOut, LOW);

  if(success == 1) {
    C = (float)timerend/(float)rangeDMM;
  }
  else if(success == -1) {
    C = -1;
  }
  else {
    C = -2;
  }
  if(rangeDMM == 1000000) {
    Serial.println(C, 4);
  }
  else {
    Serial.println(C, 3);
  }
}

void getDC() {
  // Purpose: Gets DC voltage supply level from python, outputs it at the DC voltage supply pin.
  // Date added: Aug. 2017
  // Date modified: Nov 2018
  
  char dcbuff[5];
  Serial.readBytesUntil('\n', dcbuff, 5);
  dcbuff[4] = '\0';
  int dcoutput = atoi(dcbuff);
  analogWrite(dcpin, dcoutput);
  Serial.println('0');
  
}

void measureRange(int which) { 
  // Purpose: calculates and reports the voltage range seen at 'which' ADC
  // Date added: Aug. 2017
  // Date modified: 
  
  int maxval = 0;
  int minval = 255;
  int val = 0;
  int val1 = 0;
  int readfrom;
  //char which = Serial.read();
  if(which == 0) {
    readfrom = A0;
  }
  if(which == 1) {
    readfrom = A2;
  }
  for(int counter = 0; counter < numValues; counter++) {
    readValues0[counter] = analogRead(readfrom);
    if(readValues0[counter] > maxval) {
      maxval = readValues0[counter];
    }
    if(readValues0[counter] < minval) {
      minval = readValues0[counter];
    }
  }
  Serial.println(minval);
  Serial.println(maxval);
}


void getFreq() {
  // Purpose: Receives function generator frequency information from python. Updates tuning word and triggers output table regeneration.
  // Date added: Aug. 2017
  // Data modified: Nov 2018
  
  Serial.readBytesUntil('\n', freqbuff, 6);
  freqbuff[6] = '\0';
  int received = atoi(freqbuff);
  freq = (float)received;
  M = ((float)freq * (float)pow(2,table_res)) / (float)f_clk;
  m = M*pow(2, m_extend);
  Serial.println('0');
  delay(1);
}


void getAmp() { 
  // Purpose: reads and parses wave amplitude from python
  // Date added: Aug. 2017
  // Data modified: 
  
  Serial.readBytesUntil('\n', ampbuff, 5);
  ampbuff[5] = '\0';
  int received = atoi(ampbuff);
  amp = (float)received / 4095.0;
  ypos = 4096 - (10.0*amp + (5.0-5.0*amp))*409.6; 
  Serial.println('0');
  delay(1);
}

void getOffset() {
  // Purpose: reads and parses DC offset from python
  // Date added: Aug. 2017
  // Data modified: 
  
  Serial.readBytesUntil('\n', offsetbuff, 5);
  offsetbuff[5] = '\0';
  dcoffset = atoi(offsetbuff);
  Serial.println('0');
}


void prep() {
  // Purpose: populates the output tables for the DAC
  // Date added: Aug. 2017
  // Data modified: Jan. 2019: MRouble revamped strategy to allow arbitrary waveform generation 

  int val = 0;
  long shift;
  if(wave == 1) {
    for(int i = 0; i<bufferlen; i++) {
      pac = pac + m;
      if(pac >= pac_comp) {
        pac = pac - pac_comp;
      }
      shift =  (pac >> (m_extend));
      place = shift%((long)pow(2, table_res));
      
      val = amp*sinetable[place] + dcoffset - (amp*4095)*0.5;
      if(val > 4095) {
        val = 4095;
      }
      else if(val < 0) {
        val = 0;
      }  
      alttable[i] = val;
      //pac = pac + m;
      
    }
  }
  if(wave == 2) {
    for(int i = 0; i<bufferlen; i++) {

      pac = pac + m;
      if(pac >= pac_comp) {
        pac = pac - pac_comp;
      }
      shift =  (pac >> (m_extend));
      place = shift%((int)pow(2, table_res));
      val = amp*tritable[place] + dcoffset - (amp*4095)*0.5;
      if(val > 4095) {
        val = 4095;
      }
      else if(val < 0) {
        val = 0;
      }
      alttable[i] = val;
    }
  }
  if(wave == 3) {
    for(int i = 0; i<bufferlen; i++) {
      pac = pac + m;
      if(pac > pac_comp) {
        pac = pac - pac_comp;
      }
      shift =  (pac >> (m_extend));
      place = shift%((int)pow(2, table_res));
      val = amp*lintable[place] + dcoffset - (amp*4095)*0.5;
      if(val > 4095) {
        val = 4095;
      }
      else if(val < 0) {
        val = 0;
      }
      alttable[i] = val;
    }
  }
  if(wave == 4) {
    for(int i = 0; i<bufferlen; i++) {
      pac = pac + m;
      if(pac > pac_comp) {
        pac = pac - pac_comp;
      }
      shift =  (pac >> (m_extend));
      place = shift%((int)pow(2, table_res)); 
      val = amp*squaretable[place] + dcoffset - (amp*4095)*0.5;
      if(val > 4095) {
        val = 4095;
      }
      else if(val < 0) {
        val = 0;
      }
      alttable[i] = val;
    }
  }
  if(wave == 5) {
    for(int i = 0; i<bufferlen; i++) {
      pac = pac + m;
      shift =  (pac >> (m_extend));
      place = shift%((int)pow(2, table_res));

      if(pac > pac_comp) {
        pac = pac - pac_comp;
      }
      val = amp*noisetable[place] + dcoffset - (amp*4095)*0.5;
      if(val > 4095) {
        val = 4095;
      }
      else if(val < 0) {
        val = 0;
      }
      alttable[i] = val; 
    }
  }
  if(wave == 6) {
    for(int i = 0; i<bufferlen; i++) {
      val = dcoffset;
      if(val <= 4095 && val>0) {
        alttable[i] = val;   
      }
      else if(val <= 0) {
        alttable[i] = 0;
      }
      else {
        alttable[i] = 4095;
      }
    }
  }
  
  if(flag1 == true) {
    memcpy(table1, &alttable[0],sizeof(alttable));
    prep_flag = false;
    return;
  }
  else {
    memcpy(table2, &alttable[0], sizeof(alttable));
    prep_flag = false;
    return;
  }
}


void getTrigger() {
  // Purpose: reads oscilloscope trigger level (0 to 256)
  // Author: Maclean Rouble
  // Date added: Aug. 2017
  // Data modified: Oct. 2018
  Serial.readBytesUntil('\n', trigbuff, 4); // three digits indicate trigger level
  trigbuff[3] = '\0';
  trig = atoi(trigbuff);
  Serial.println('0');
}

void getTriggerChannel() {
  // Purpose: reads oscilloscope trigger channel (1 for ch1 or 0 for ch2)
  // Author: Maclean Rouble
  // Date added: Oct. 2018
  // Date modified: Oct. 2018
  Serial.readBytesUntil('\n', chbuff, 2);
  chbuff[1] = '\0';
  trigchannel = atoi(chbuff);
  Serial.println('0');
}

void twoChannelOsc() {
  // Purpose: use ADC to read values from both oscilloscope channels
  //          You can make this algorithm more efficient, but sending large arrays over serial is slow
  //            compared to sampling, so there's some headroom here, and atm I've gone for readability
  // Author: Maclean Rouble
  // Date added: Aug. 2017
  // Date modified: Oct. 2018
  int counter = 0;
  int maxval[2];
  int minval[2];
  int val[2];
  int prev[2];
  for(int i=0; i<=1;i++) {
    maxval[i] = 0;
    minval[i] = 255;
    val[i] = 0;
    prev[i] = 0;
  }
  
  int val1 = 0;
  int channel = 0;

  // do a full read through to find the max and min vals present on each channel
  for(channel = 0; channel <= 1; channel++) {
    for(counter = 0; counter < numValues; counter++) {
      result = adc->analogSynchronizedRead(readPin0, readPin1);
      if(channel == 0) {
        val[channel] = result.result_adc0;
      }
      else if(channel == 1) {
        val[channel] = result.result_adc1;
      }
      else {
        //digitalWrite(ledpin, !digitalRead(ledpin));
        break;
        channel = 0; 
        val[channel] = analogRead(readPin0);
      }
      readValues[channel][counter] = val[channel]; //type collision? analogRead returns byte or int?
    
      if(val[channel] > maxval[channel]) {
        maxval[channel] = val[channel];
      }
      if(val[channel] < minval[channel]) {
        minval[channel] = val[channel];
      } 
    }
  }
    // now actually record.
    // start recording on both channels when trig ch gets within range
    counter = 0;
    
    if(trig >= minval[trigchannel] && trig <= maxval[trigchannel]) { // if the trig level is inside the wave on trig ch, start checking
      digitalWrite(ledpin, HIGH);
      //Serial.println("In range");
      int checker = 0;
      while(checker == 0) {
        result = adc->analogSynchronizedRead(readPin0, readPin1);
        prev[0] = result.result_adc0;
        prev[1] = result.result_adc1;
        result = adc->analogSynchronizedRead(readPin0, readPin1);
        val[0] = result.result_adc0;
        val[1] = result.result_adc1;
        if(val[trigchannel] > trig && prev[trigchannel] <= trig) {
          checker = 1;
        }
        counter = counter + 1;
        if(counter > numValues) {
          checker = 1; // break if we don't find it to not get stuck in the loop
        }
      }

      for(counter = 0; counter < numValues; counter++) {
        result = adc->analogSynchronizedRead(readPin0, readPin1);
        readValues[0][counter] = result.result_adc0;
        readValues[1][counter] = result.result_adc1;
      }
      twoChannelSend();
    }
    else {
      twoChannelSend(); // if trig level is outside the wave, just send what we read during the first pass
    }
}


void twoChannelSend() {
  // Purpose: transmits recorded oscilloscope data to python.
  // Author: Maclean Rouble
  // Date added: Aug. 2017
  // Data modified: Oct. 2018
  
  Serial.flush();
  for (int i = 0; i < numValues; i++) {
    Serial.print(readValues[1][i]);
    Serial.print(".");
  }
  Serial.println("");
  delay(10);
  
  for (int i = 0; i < numValues; i++) {
    Serial.print(readValues[0][i]);
    Serial.print(".");
  }
  Serial.println("");
  digitalWrite(ledpin, LOW);
  delay(10);
}



void loop() { //the actual execution loop
  if(Serial.available()>0) { //if we're getting a command from python
    readFromSerial();
  }
  if(prep_flag) {
    prep();
  }

}


